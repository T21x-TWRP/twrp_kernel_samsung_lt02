## arch/arm/configs/pxa986_lt02_wifi_defconfig
```kconfig
CONFIG_WIFIONLY_BOARD=y
# CONFIG_VIBRATOR_ANDROID is not set
# CONFIG_ANDROID_TIMED_GPIO is not set
# CONFIG_SEC_IRLED is not set
# CONFIG_SENSORS_ASP01 is not set
```
